/*
 * Copyright 2023 AVNET
 *
 * This program is free software; you can redistribute it and/or
 * modify it under the terms of the GNU General Public License
 * as published by the Free Software Foundation; either version 2
 * of the License, or (at your option) any later version.
 *
 * This program is distributed in the hope that it will be useful,
 * but WITHOUT ANY WARRANTY; without even the implied warranty of
 * MERCHANTABILITY or FITNESS FOR A PARTICULAR PURPOSE.  See the
 * GNU General Public License for more details.
 */

/dts-v1/;
/plugin/;

#include "../imx8mm-pinfunc.h"

/* 40-pin extended GPIO */

&iomuxc {
	pinctrl_hog: hoggrp {
		fsl,pins = <
			/*Default GPIOs*/
			MX8MM_IOMUXC_GPIO1_IO14_GPIO1_IO14		0x16	/* PIN 7,  GPIO 4  */
			MX8MM_IOMUXC_NAND_WE_B_GPIO3_IO17		0x16	/* PIN 11, GPIO 17 */
			MX8MM_IOMUXC_NAND_CE3_B_GPIO3_IO4		0x16	/* PIN 13, GPIO 27 */
			MX8MM_IOMUXC_NAND_WP_B_GPIO3_IO18		0x16	/* PIN 15, GPIO 22 */
			MX8MM_IOMUXC_UART4_RXD_GPIO5_IO28		0x16	/* PIN 22, GPIO 25 */
			MX8MM_IOMUXC_NAND_READY_B_GPIO3_IO16	0x16	/* PIN 36, GPIO 16 */
			MX8MM_IOMUXC_GPIO1_IO10_GPIO1_IO10		0x16	/* PIN 37, GPIO 26 */
			MX8MM_IOMUXC_GPIO1_IO01_GPIO1_IO1		0x16	/* PIN 26, GPIO 8  */
			MX8MM_IOMUXC_GPIO1_IO15_GPIO1_IO15		0x16	/* PIN 29, GPIO 5  */
			MX8MM_IOMUXC_SAI2_MCLK_GPIO4_IO27		0x16	/* PIN 31, GPIO 6  */
		>;
	};
};

