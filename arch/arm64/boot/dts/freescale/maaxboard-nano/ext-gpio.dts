/*
 * Copyright 2023 AVNET
 *
 * This program is free software; you can redistribute it and/or
 * modify it under the terms of the GNU General Public License
 * as published by the Free Software Foundation; either version 2
 * of the License, or (at your option) any later version.
 *
 * This program is distributed in the hope that it will be useful,
 * but WITHOUT ANY WARRANTY; without even the implied warranty of
 * MERCHANTABILITY or FITNESS FOR A PARTICULAR PURPOSE.  See the
 * GNU General Public License for more details.
 */

/dts-v1/;
/plugin/;

#include "../imx8mn-pinfunc.h"

/* 40-pin extended GPIO */

&iomuxc {
	pinctrl_hog: hoggrp {
		fsl,pins = <
			/*Default GPIOs*/
			MX8MN_IOMUXC_GPIO1_IO14_GPIO1_IO14      0x16    /* PIN 7,  GPIO 14  */
			MX8MN_IOMUXC_SAI3_MCLK_GPIO5_IO2        0x16    /* PIN 11, GPIO 130 */
			MX8MN_IOMUXC_SAI3_RXC_GPIO4_IO29        0x16    /* PIN 13, GPIO 125 */
			MX8MN_IOMUXC_SAI3_RXFS_GPIO4_IO28       0x16    /* PIN 15, GPIO 124 */
			MX8MN_IOMUXC_ECSPI2_MISO_GPIO5_IO12     0x16    /* PIN 22, GPIO 140 */
			MX8MN_IOMUXC_ECSPI2_SS0_GPIO5_IO13      0x16    /* PIN 36, GPIO 141 */
			MX8MN_IOMUXC_ECSPI2_SCLK_GPIO5_IO10     0x16    /* PIN 37, GPIO 138 */
			MX8MN_IOMUXC_SPDIF_EXT_CLK_GPIO5_IO5    0x16    /* PIN 26, GPIO 133 */
			MX8MN_IOMUXC_GPIO1_IO15_GPIO1_IO15      0x16    /* PIN 29, GPIO 15  */
			MX8MN_IOMUXC_GPIO1_IO01_GPIO1_IO1       0x16    /* PIN 31, GPIO 1   */	
			MX8MN_IOMUXC_UART4_RXD_GPIO5_IO28       0x16    /* PIN 16, GPIO 156 */
		>;
	};
};

