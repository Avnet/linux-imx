/*
 * Copyright 2021 AVNET
 *
 * This program is free software; you can redistribute it and/or
 * modify it under the terms of the GNU General Public License
 * as published by the Free Software Foundation; either version 2
 * of the License, or (at your option) any later version.
 *
 * This program is distributed in the hope that it will be useful,
 * but WITHOUT ANY WARRANTY; without even the implied warranty of
 * MERCHANTABILITY or FITNESS FOR A PARTICULAR PURPOSE.  See the
 * GNU General Public License for more details.
 */

/dts-v1/;
/plugin/;

/* 4 x silicon digital microphones */

/ {
	compatible = "avnet,maaxboard-nano", "fsl,imx8mn";

	fragment@0 {
		target-path = "/";
		__overlay__ {
			sound-micfil {
				compatible = "fsl,imx-audio-micfil";
				model = "imx-audio-micfil";
				cpu-dai = <&micfil>;
			};
		};
	};

	fragment@1 {
		target = <&micfil>;
		__overlay__ {
			status = "okay";
		};
	};
};
