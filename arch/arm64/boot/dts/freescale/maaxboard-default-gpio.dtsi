/*
 * Copyright 2019 EMBEST
 *
 * This program is free software; you can redistribute it and/or
 * modify it under the terms of the GNU General Public License
 * as published by the Free Software Foundation; either version 2
 * of the License, or (at your option) any later version.
 *
 * This program is distributed in the hope that it will be useful,
 * but WITHOUT ANY WARRANTY; without even the implied warranty of
 * MERCHANTABILITY or FITNESS FOR A PARTICULAR PURPOSE.  See the
 * GNU General Public License for more details.
 */

/* 40-pin extended GPIO, as the default gpio function */

&iomuxc {
	pinctrl-names = "default";
	pinctrl-0 = <&pinctrl_hog>;

	imx8mq-evk {
		pinctrl_hog: hoggrp {
			fsl,pins = <
				MX8MQ_IOMUXC_I2C2_SCL_GPIO5_IO16		0x19	/* PIN 3,  GPIO 2  */
				MX8MQ_IOMUXC_I2C2_SDA_GPIO5_IO17		0x19	/* PIN 5,  GPIO 3  */
				MX8MQ_IOMUXC_I2C3_SCL_GPIO5_IO18		0x19	/* PIN 28, GPIO 1  */
				MX8MQ_IOMUXC_I2C3_SDA_GPIO5_IO19		0x19	/* PIN 27, GPIO 0  */
				MX8MQ_IOMUXC_UART2_RXD_GPIO5_IO24		0x19	/* PIN 16, GPIO 23 */
				MX8MQ_IOMUXC_UART2_TXD_GPIO5_IO25		0x19	/* PIN 18, GPIO 24 */
				MX8MQ_IOMUXC_ECSPI1_MOSI_GPIO5_IO7		0x19	/* PIN 13, GPIO 10 */
				MX8MQ_IOMUXC_ECSPI1_MISO_GPIO5_IO8		0x19	/* PIN 21, GPIO 9  */
				MX8MQ_IOMUXC_ECSPI1_SCLK_GPIO5_IO6		0x19	/* PIN 23, GPIO 11 */
				MX8MQ_IOMUXC_ECSPI1_SS0_GPIO5_IO9		0x19	/* PIN 24, GPIO 8  */
				MX8MQ_IOMUXC_NAND_READY_B_GPIO3_IO16	0x19	/* PIN 7,  GPIO 4  */
				MX8MQ_IOMUXC_NAND_WE_B_GPIO3_IO17		0x19	/* PIN 11, GPIO 17 */
				MX8MQ_IOMUXC_NAND_DATA02_GPIO3_IO8		0x19	/* PIN 13, GPIO 27 */
				MX8MQ_IOMUXC_NAND_DATA03_GPIO3_IO9		0x19	/* PIN 15, GPIO 22 */
				MX8MQ_IOMUXC_NAND_RE_B_GPIO3_IO15		0x19	/* PIN 22, GPIO 25 */
				MX8MQ_IOMUXC_GPIO1_IO03_GPIO1_IO3		0x19	/* PIN 36, GPIO 16 */
				MX8MQ_IOMUXC_NAND_DATA05_GPIO3_IO11		0x19	/* PIN 37, GPIO 26 */
				MX8MQ_IOMUXC_NAND_CE1_B_GPIO3_IO2		0x19	/* PIN 26, GPIO 8  */
				MX8MQ_IOMUXC_GPIO1_IO15_GPIO1_IO15		0x19	/* PIN 32, GPIO 12 */
				MX8MQ_IOMUXC_GPIO1_IO13_GPIO1_IO13		0x19	/* PIN 33, GPIO 13 */
				MX8MQ_IOMUXC_NAND_CLE_GPIO3_IO5			0x19	/* PIN 29, GPIO 5  */
				MX8MQ_IOMUXC_NAND_DATA04_GPIO3_IO10		0x19	/* PIN 31, GPIO 6  */
				MX8MQ_IOMUXC_SAI2_TXC_GPIO4_IO25		0x19	/* PIN 12, GPIO 18 */
				MX8MQ_IOMUXC_SAI2_RXFS_GPIO4_IO21		0x19	/* PIN 35, GPIO 19 */
				MX8MQ_IOMUXC_SAI2_RXD0_GPIO4_IO23		0x19	/* PIN 38, GPIO 20 */
				MX8MQ_IOMUXC_SAI2_TXD0_GPIO4_IO26		0x19	/* PIN 40, GPIO 21 */
			>;
		};
	};
};