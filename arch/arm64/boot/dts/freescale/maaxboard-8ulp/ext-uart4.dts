/*
 * Copyright 2022 AVNET
 *
 * This program is free software; you can redistribute it and/or
 * modify it under the terms of the GNU General Public License
 * as published by the Free Software Foundation; either version 2
 * of the License, or (at your option) any later version.
 *
 * This program is distributed in the hope that it will be useful,
 * but WITHOUT ANY WARRANTY; without even the implied warranty of
 * MERCHANTABILITY or FITNESS FOR A PARTICULAR PURPOSE.  See the
 * GNU General Public License for more details.
 */

/dts-v1/;
/plugin/;

#include "../imx8ulp-pinfunc.h"

/* 40-pin extended GPIO, expanded into lpuart4 */

&lpuart4 {
	status = "okay";
};

&iomuxc1 {
	pinctrl-0 = <&pinctrl_extgpio &pinctrl_exti2c4 &pinctrl_extspi5 &pinctrl_extuart4>;
	pinctrl_extuart4: extuart4_grp {
		fsl,pins = <
			MX8ULP_PAD_PTF10__LPUART4_TX	0x3
			MX8ULP_PAD_PTF11__LPUART4_RX	0x3
		>;
	};
};

