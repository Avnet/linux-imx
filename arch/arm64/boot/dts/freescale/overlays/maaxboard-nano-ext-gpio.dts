/*
 * Copyright 2021 AVNET
 *
 * This program is free software; you can redistribute it and/or
 * modify it under the terms of the GNU General Public License
 * as published by the Free Software Foundation; either version 2
 * of the License, or (at your option) any later version.
 *
 * This program is distributed in the hope that it will be useful,
 * but WITHOUT ANY WARRANTY; without even the implied warranty of
 * MERCHANTABILITY or FITNESS FOR A PARTICULAR PURPOSE.  See the
 * GNU General Public License for more details.
 */

/dts-v1/;
/plugin/;

#include "../imx8mn-pinfunc.h"

/* 40-pin extended GPIO, expanded into SPI, I2C, PWM and other interfaces */

/ {
	compatible = "avnet,maaxboard-nano", "fsl,imx8mn";

	fragment@0 {
		target = <&iomuxc>;
		__overlay__ {
			pinctrl-names = "default";
			pinctrl-0 = <&pinctrl_hog>;
			imx8mq-evk {
				pinctrl_hog: hoggrp {
					fsl,pins = <
						MX8MN_IOMUXC_GPIO1_IO14_GPIO1_IO14		0x16	/* PIN 7,  gpio14  */
						MX8MN_IOMUXC_SAI3_MCLK_GPIO5_IO2		0x16	/* PIN 11, gpio130 */
						MX8MN_IOMUXC_SAI3_RXC_GPIO4_IO29		0x16	/* PIN 13, gpio125 */
						MX8MN_IOMUXC_SAI3_RXFS_GPIO4_IO28		0x16	/* PIN 15, gpio124 */
						MX8MN_IOMUXC_GPIO1_IO15_GPIO1_IO15		0x16	/* PIN 29, gpio15 */
						MX8MN_IOMUXC_GPIO1_IO01_GPIO1_IO1		0x16	/* PIN 31, gpio1 */
						MX8MN_IOMUXC_SPDIF_EXT_CLK_GPIO5_IO5	0x16	/* PIN 26, gpio133 */
#if 0
						/* Rev0.0 */
						MX8MN_IOMUXC_SD1_DATA6_GPIO2_IO8		0x16	/* PIN 22, gpio40 */
						MX8MN_IOMUXC_SD1_STROBE_GPIO2_IO11		0x16	/* PIN 36, gpio43 */
						MX8MN_IOMUXC_SD1_DATA7_GPIO2_IO9		0x16	/* PIN 37, gpio41 */
#else
						/* Rev2.0 */
						MX8MN_IOMUXC_ECSPI2_MISO_GPIO5_IO12		0x16	/* PIN 22, gpio140 */
						MX8MN_IOMUXC_ECSPI2_SS0_GPIO5_IO13		0x16	/* PIN 36, gpio141 */
						MX8MN_IOMUXC_ECSPI2_SCLK_GPIO5_IO10		0x16	/* PIN 37, gpio138 */
#endif
					>;
				};
			};
		};
	};
};
