/*
 * Copyright 2022 AVNET
 *
 * This program is free software; you can redistribute it and/or
 * modify it under the terms of the GNU General Public License
 * as published by the Free Software Foundation; either version 2
 * of the License, or (at your option) any later version.
 *
 * This program is distributed in the hope that it will be useful,
 * but WITHOUT ANY WARRANTY; without even the implied warranty of
 * MERCHANTABILITY or FITNESS FOR A PARTICULAR PURPOSE.  See the
 * GNU General Public License for more details.
 */

/dts-v1/;
/plugin/;

#include "../imx8ulp-pinfunc.h"
#include <dt-bindings/gpio/gpio.h>

/* 40-pin extended GPIO, expanded into lpspi5 */

&lpspi5 {
	fsl,spi-num-chipselects = <1>;
	cs-gpios = <&gpiof 19 GPIO_ACTIVE_LOW>;
	status = "okay";

	#address-cells = <1>;
	#size-cells = <0>;

	spidev1: spi@0 {
		reg = <0>;
		compatible = "semtech,sx1301";
		spi-max-frequency = <1000000>;
	};	
};

&iomuxc1 {
	pinctrl-0 = <&pinctrl_extgpio &pinctrl_exti2c4 &pinctrl_extspi5 &pinctrl_extuart4>;

	pinctrl_extspi5: extspi5_grp {
		fsl,pins = <
			MX8ULP_PAD_PTF16__LPSPI5_SIN	0x3
			MX8ULP_PAD_PTF17__LPSPI5_SOUT	0x3
			MX8ULP_PAD_PTF18__LPSPI5_SCK	0x3
			MX8ULP_PAD_PTF19__LPSPI5_PCS0	0x3
		>;
	};	
};

