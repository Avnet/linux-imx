## drivers/input/touchscreen/focaltech_touch/Kconfig
```kconfig
#
# Focaltech Touchscreen driver configuration
#

config TOUCHSCREEN_FT5426
        bool "Focaltech Touchscreen"
		depends on I2C
		default n
		help
		  Say Y here if you have Focaltech touch panel.
		  If unsure, say N.

config TOUCHSCREEN_FT5426_DIRECTORY
    string "Focaltech ts directory name"
    default "focaltech_touch"
    depends on TOUCHSCREEN_FT5426
```
